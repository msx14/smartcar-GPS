#include  "OLED.h" 
#include  "headfile.h"

#define OLED_SCL(x)  gpio_set (OLED_SCL_PIN	, x)
#define OLED_SDA(x)  gpio_set (OLED_SDA_PIN	, x)
#define OLED_RST(x)  gpio_set (OLED_RST_PIN	, x)
#define OLED_DC(x)   gpio_set (OLED_DC_PIN	, x)
#define OLED_CS(x)   gpio_set (OLED_CS_PIN  , x)

unsigned char Draw[]=
{
    0xfc,0x04,0x07,0x01,0x01,0x07,0x04,0xfc,0xff,0x80,0x80,0x80,0x80,0x80,0x80,0xff,//没电 0
    0xfc,0x04,0x07,0x01,0x01,0x07,0x04,0xfc,0xff,0x80,0xa0,0xa0,0xa0,0xa0,0x80,0xff,//一格 1
    0xfc,0x04,0x07,0x01,0x01,0x07,0x04,0xfc,0xff,0x80,0xb0,0xb0,0xb0,0xb0,0x80,0xff,//两格
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    0x00,0xE0,0x10,0x08,0x08,0x10,0xE0,0x00,0x00,0x00,0x31,0x22,0x22,0x11,0x0F,0x00,//35  9
    
};


/*****************************************************/
/******************  ASCII码字库    ******************/
/*****************************************************/

const unsigned char Font_8x16[1520]=
{
    0x00,0x00,0x00,0x00,0x00,0x00,0x00,0x00,0x00,0x00,0x00,0x00,0x00,0x00,0x00,0x00,//  0
    0x00,0x00,0x00,0xF8,0x00,0x00,0x00,0x00,0x00,0x00,0x00,0x33,0x30,0x00,0x00,0x00,//! 1
    0x00,0x10,0x0C,0x06,0x10,0x0C,0x06,0x00,0x00,0x00,0x00,0x00,0x00,0x00,0x00,0x00,//" 2
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    0x00,0x06,0x01,0x01,0x02,0x02,0x04,0x04,0x00,0x00,0x00,0x00,0x00,0x00,0x00,0x00,//~ 94
};

const unsigned char my_font_16x16[][32] =
{
    0x80,0x82,0x82,0x82,0xfe,0x82,0x82,0x82,0x82,0x82,0xfe,0x82,0x82,0x82,0x80,0x00,
    0x00,0x80,0x40,0x30,0x0f,0x00,0x00,0x00,0x00,0x00,0xff,0x00,0x00,0x00,0x00,0x00,// 0开 
    0x00,0x00,0x10,0x11,0x16,0x10,0x10,0xf0,0x10,0x10,0x14,0x13,0x10,0x00,0x00,0x00,
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    0x04,0x04,0x7c,0x03,0x00,0x00,0xff,0x09,0x09,0x09,0x49,0x89,0x7f,0x00,0x00,0x00,//51消
    
};


//厦门大学
const unsigned char gimage_xmdx[512] = 
{
    0x00,0x00,0x00,0x00,0x00,0x00,0x00,0x00,0x00,0x00,0x00,0x80,0x80,0x40,0x20,0xa0,
    0x50,0x48,0x28,0x0c,0x14,0x14,0x22,0xea,0x8a,0x02,0x40,0x05,0x05,0x05,0x05,0x05,
    0x05,0x05,0x05,0x05,0x05,0x60,0xe2,0x6a,0x8a,0x02,0x94,0x54,0x28,0x28,0x58,0x50,
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    0x05,0x04,0x02,0x01,0x01,0x00,0x00,0x00,0x00,0x00,0x00,0x00,0x00,0x00,0x00,0x00,
};

const unsigned char gimage_xmdx128[2048] = 
{ 
    0x00,0x00,0x00,0x00,0x00,0x00,0x00,0x00,0x00,0x00,0x00,0x00,0x00,0x00,0x00,0x00,//1
    0x00,0x00,0x00,0x00,0x00,0x00,0x00,0x00,0x00,0x00,0x00,0x00,0x00,0x00,0x00,0x00,//2
    0x00,0x00,0x80,0x80,0xc0,0xc0,0x60,0x60,0x30,0x30,0x30,0x18,0x98,0x98,0x8c,0x8c,//3
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    0x00,0x00,0x00,0x00,0x00,0x00,0x00,0x00,0x00,0x00,0x00,0x00,0x00,0x00,0x00,0x00,//128
};
/******************************************************/
/********************  OLED函数    ********************/
/******************************************************/


/*--------------------*OLED写数据*--------------------*/

void OLED_Write_Data(uint8 data)
{
   	uint8 i=8;
	
    OLED_CS(0); //使能信号端，拉低时正常使用
	OLED_DC(1);
	OLED_SCL(0);
	while(i--)
	{
	  	if(data&0x80){OLED_SDA(1);}
	  	else{OLED_SDA(0);}
	  	OLED_SCL(1);
		
	  	OLED_SCL(0);
	  	data<<=1;
	}
    OLED_CS(1); //使能信号端，拉低时正常使用
}

/*--------------------*OLED写命令*--------------------*/

void OLED_Write_Command(unsigned char cmd)
{
    uint8 i=8;
    
	OLED_CS(0); //使能信号端，拉低时正常使用
	OLED_DC(0);
	OLED_SCL(0);;
	
	while(i--)
	{
		if(cmd&0x80){OLED_SDA(1);}
		else{OLED_SDA(0);}
		OLED_SCL(1);
		
		OLED_SCL(0);
		cmd<<=1;
	}
    OLED_CS(1); //使能信号端，拉低时正常使用	
}

/*-------------------*整型转字符串*-------------------*/

void OLED_Set_Pos(unsigned char x,unsigned char y)
{ 
    OLED_Write_Command(0xb0+y);
    OLED_Write_Command(((x&0xf0)>>4)|0x10);
    OLED_Write_Command(x&0x0f); 
} 

/*-------------------*整型转字符串*-------------------*/

void OLED_Fill(unsigned char Bmp_data)
{
    unsigned char y,x;
    
    for(y=0;y<8;y++)
    {
        OLED_Write_Command(0xb0+y);
        OLED_Write_Command(0x01);
        OLED_Write_Command(0x10);
        for(x=0;x<X_WIDTH;x++)
            OLED_Write_Data(Bmp_data);
    }
}

/*---------------------*OLED清屏*---------------------*/

void OLED_Clear(void)
// 全部写上0
{
#if _USE_LCD
    lcd_clear(BGCOLOR);
#elif _USE_IPS
	ips_clear(IPS_BGCOLOR);
#else
    OLED_Fill(0x00);
#endif
}

void OLED_IO_Init(void)  
{
    gpio_init(OLED_SCL_PIN,GPO,1,GPIO_PIN_CONFIG);
    gpio_init(OLED_SDA_PIN,GPO,1,GPIO_PIN_CONFIG);
    gpio_init(OLED_RST_PIN,GPO,1,GPIO_PIN_CONFIG); 
    gpio_init(OLED_DC_PIN,GPO,1,GPIO_PIN_CONFIG); 
}
void OLED_Init(void)        
{
    unsigned int Temp_Count;
    OLED_IO_Init();
    OLED_SCL(1);
    OLED_RST(0);
    for(Temp_Count=0;Temp_Count<50000;Temp_Count++);
    
    OLED_RST(1);
    //??????????????????,???RC????
    OLED_Write_Command(0xAE|0x00);			                // Display Off (0x00/0x01)
    OLED_Write_Command(0xD5);OLED_Write_Command(0x80);	// Set Clock as 100 Frames/Sec
    OLED_Write_Command(0xA8);OLED_Write_Command(0x3F);	// 1/64 Duty (0x0F~0x3F)
    OLED_Write_Command(0xD3);OLED_Write_Command(0x00);	// Shift Mapping RAM Counter (0x00~0x3F)
    OLED_Write_Command(0x40|0x00);			                // Set Mapping RAM Display Start Line (0x00~0x3F)
    OLED_Write_Command(0x8D);OLED_Write_Command(0x10|0x04);	    // Enable Embedded DC/DC Converter (0x00/0x04)
    OLED_Write_Command(0x20);OLED_Write_Command(0x02);		      // Set Page Addressing Mode (0x00/0x01/0x02)
    OLED_Write_Command(0xA0|0x01);                      // Set SEG/Column Mapping     0x00???? 0x01??
    OLED_Write_Command(0xC0|0x08);			                // Set COM/Row Scan Direction 0x00???? 0x08??
    OLED_Write_Command(0xDA);OLED_Write_Command(0x02|0x10);	    // Set Sequential Configuration (0x00/0x10)
    OLED_Write_Command(0x81);OLED_Write_Command(0xCF);	  // Set SEG Output Current
    OLED_Write_Command(0xD9);OLED_Write_Command(0xF1);	        // Set Pre-Charge as 15 Clocks & Discharge as 1 Clock
    OLED_Write_Command(0xDB);OLED_Write_Command(0x40);			    // Set VCOM Deselect Level
    OLED_Write_Command(0xA4|0x00);		                  // Disable Entire Display On (0x00/0x01)
    OLED_Write_Command(0xA6|0x00);		                  // Disable Inverse Display On (0x00/0x01)  
    OLED_Write_Command(0xAE|0x01);		                  // Display On (0x00/0x01)
    OLED_Clear();                                       // ????
    OLED_Set_Pos(0,0); 
}


/*-------------------*整型转字符串*-------------------*/

signed int Int_To_String(signed long Int_Num,signed char String[])
// 返回字符串长度
{
    signed int Num_Length=0;
    signed char Negative_Flag=0;
    signed char *Point_p=String;                //做换向时用的指针
    signed char *Point_s=String;
    if(Int_Num<0)
    {
        Negative_Flag=1;
        Int_Num=0-Int_Num;
    }
    if(Int_Num==0)
        String[Num_Length++]='0';
    while(Int_Num>0)
    {
        String[Num_Length++]=Int_Num%10+'0';
        Int_Num=Int_Num/10;
    }
    if(Negative_Flag)
        String[Num_Length++]='-';
    String[Num_Length]='\0';
    Point_p=String+Num_Length-1;                //将P指针指向字符串结束标志之前
    
    for(;Point_p-Point_s>0;Point_p--,Point_s++) //将字符串中存储的数调头   
    {   
        *Point_s^=*Point_p;   
        *Point_p^=*Point_s;   
        *Point_s^=*Point_p;   
    }   
    return(Num_Length);
}

/*------------------*浮点型转字符串*------------------*/

signed int Float_To_String(float Float_Num,signed char String[])
// Dot_Size为小数点后边保留位数
// 返回字符串长度
{
    signed int Num_Length=0;
    signed int Temp_i=0;
    signed char *Point_p=String;                //做换向时用的指针
    signed char *Point_s=String;
    signed char Negative_Flag=0;
    signed long Predot_Num;
    signed long Afterdot_Num;
    float Afterdot_Float;
    
    if(Float_Num<0)
    {
        Negative_Flag=1;
        Float_Num=0-Float_Num;
    }
    
    Predot_Num=(signed long)Float_Num;          //将小数点之前的数变为整数
    Afterdot_Float=Float_Num-Predot_Num;        //单独取出小数点之后的数
    for(Temp_i=Dot_Size;Temp_i>0;Temp_i--)
    {
        Afterdot_Float=Afterdot_Float*10;
    }
    Afterdot_Num=(signed long)Afterdot_Float;
    
    Temp_i=Dot_Size;
    
    while(Afterdot_Num>0|Temp_i>0)
    {
        Temp_i--;
        String[Num_Length++]=Afterdot_Num%10+'0';
        Afterdot_Num=Afterdot_Num/10;
    }
    String[Num_Length++]='.';
    
    if(Predot_Num==0)                           //处理小数点前为0的情况
        String[Num_Length++]='0';
    
    while(Predot_Num>0)
    {
        String[Num_Length++]=Predot_Num%10+'0';
        Predot_Num=Predot_Num/10;
    }
    
    if(Negative_Flag==1)
        String[Num_Length++]='-';
    String[Num_Length]='\0';                    //加上字符串结束标志
    
    Point_p=String+Num_Length-1;                //将P指针指向字符串结束标志之前
    
    for(;Point_p-Point_s>0;Point_p--,Point_s++) //将字符串中存储的数调头   
    {   
        *Point_s^=*Point_p;   
        *Point_p^=*Point_s;   
        *Point_s^=*Point_p;   
    }   
    
    return(Num_Length);
}


/******************************************************/
/********************  生成接口    ********************/
/******************************************************/

/*-----------------*OLED写一个字符串*-----------------*/      

void OLED_Write_String(unsigned char x,unsigned char y,signed char String[])
{
    unsigned char Temp_Char=0,Temp_i=0,Temp_j=0;
    
    while(String[Temp_j]!='\0')
    {    
        Temp_Char=String[Temp_j]-32;
        if(y>128){y=0;x++;}
        OLED_Set_Pos(y,x);    
  	for(Temp_i=0;Temp_i<8;Temp_i++)     
            OLED_Write_Data(Font_8x16[Temp_Char*16+Temp_i]);
  	OLED_Set_Pos(y,x+1);    
  	for(Temp_i=0;Temp_i<8;Temp_i++)     
            OLED_Write_Data(Font_8x16[Temp_Char*16+Temp_i+8]);  
  	y+=8;
  	Temp_j++;
    }
}

/*-----------------*OLED写一个字符*-------------------*/      

void OLED_Write_Char(unsigned char x,unsigned char y,signed char Asc) 
{
    signed char Temp_String[2];
    y=y*8;        
    Temp_String[0]=Asc;	
    Temp_String[1]='\0';			                  //字母占一个字节
    OLED_Write_String(x,y,Temp_String);	        //显示字母
}

/*-----------------*OLED写一个字符*-------------------*/      
//
//void OLED_Write_Draw(unsigned char x,unsigned char y,signed char Asc) 
//{
//    unsigned char Temp_i;
//    unsigned char Temp_Char;
//    y=y*8;        
//    
//    Temp_Char=Asc;
//    
//    OLED_Set_Pos(y,x);    
//    for(Temp_i=0;Temp_i<8;Temp_i++)     
//        OLED_Write_Data(Draw[Temp_Char*16+Temp_i]);
//    OLED_Set_Pos(y,x+1);    
//    for(Temp_i=0;Temp_i<8;Temp_i++)     
//        OLED_Write_Data(Draw[Temp_Char*16+Temp_i+8]);  
//}      


/*----------------*OLED写一个整型数据*----------------*/      

void OLED_Write_Int(unsigned char x,unsigned char y,signed int Number)
{
    signed char Temp_Buf[17];
    (void)Int_To_String(Number,Temp_Buf);
#if _USE_LCD
    LCD_DispString(y,x,Temp_Buf);
#elif _USE_IPS
	IPS_DispString(y, x, Temp_Buf);
#else
    OLED_Write_String(x,y,Temp_Buf);   
#endif
}

/*---------------*OLED写一个浮点型数据*---------------*/

void OLED_Write_Float(unsigned char x,unsigned char y,float Number)
{
    signed char Temp_Buf[17];
    (void)Float_To_String(Number,Temp_Buf);
#if _USE_LCD
    LCD_DispString(y,x,Temp_Buf);
#elif _USE_IPS
	IPS_DispString(y, x, Temp_Buf);
#else
    OLED_Write_String(x,y,Temp_Buf);   
#endif  
}


////*
////*  @brief:		显示光标
////*  @param:		需要显示的位置(1~3)及是否锁定(0或1)
////*  @return:	  void
////*  @note:     锁定前显示">" 锁定后显示"》"
////*
//void Dis_Cursor(unsigned char Position,signed char Number)
//{
//    OLED_Set_Pos(0,2*Position);
//    for(unsigned char i = 0; i < 8; i++)
//        OLED_Write_Data(Cursor[Number][i]);
//    OLED_Set_Pos(0,2*Position+1);
//    for(unsigned char i = 0; i < 8; i++)
//        OLED_Write_Data(Cursor[Number][i+8]);  
//}

///*!
//*  @brief:		oled显示16x16的汉字
//*  @param:		unsigned char x,unsigned char y,unsigned int character_line
//*  @return:	void
//*  @note:		显示汉字，character_line为数组my_font_16x16的行号，从0开始
//*/
//void dis_chinese16x16(unsigned char x,unsigned char y,unsigned char character_line)
//{    
//    if(x > 6)   x = 6;
//    if(y > 15)  y = 15;
//    y = 8 * y;         //y 从0到15  15
//    
//    oled_set_pos(y,x);
//    for(unsigned char i = 0; i < 16; i++)
//        oled_write_data( (*(*(my_font_16x16+character_line)+i)) );
//    
//    oled_set_pos(y,x+1);
//    for(unsigned char i = 0; i < 16; i++)
//        oled_write_data( (*(*(my_font_16x16+character_line)+i+16)) );
//}